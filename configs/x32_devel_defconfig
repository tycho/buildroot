## configs/x32_devel_defconfig
```kconfig
BR2_x86_64=y
BR2_x86_core_avx2=y
BR2_X32_ABI=y
BR2_ZCAT="pigz -d -c"
BR2_BZCAT="pbzip2 -dc"
BR2_XZCAT="pixzcat"
BR2_CCACHE=y
BR2_CCACHE_INITIAL_SETUP="-M4G -zc"
BR2_OPTIMIZE_3=y
BR2_KERNEL_HEADERS_3_14=y
BR2_TOOLCHAIN_BUILDROOT_GLIBC=y
BR2_GLIBC_VERSION_2_21=y
BR2_BINUTILS_VERSION_2_25=y
BR2_GCC_VERSION_4_9_X=y
BR2_GCC_STABLE_SNAPSHOT=y
BR2_TOOLCHAIN_BUILDROOT_CXX=y
BR2_GCC_ENABLE_LTO=y
BR2_GCC_ENABLE_OPENMP=y
BR2_GCC_ENABLE_GRAPHITE=y
BR2_ENABLE_LOCALE_PURGE=y
BR2_ENABLE_LOCALE_WHITELIST="C en_US en_GB"
BR2_GENERATE_LOCALE="en_US en_GB"
BR2_TARGET_GENERIC_PASSWD_SHA256=y
BR2_INIT_SYSTEMD=y
BR2_ROOTFS_SKELETON_UNIFIED_BIN=y
BR2_SYSTEM_BIN_SH_BASH=y
BR2_TARGET_GENERIC_GETTY_PORT="tty1"
BR2_TARGET_TZ_INFO=y
BR2_TARGET_LOCALTIME="America/Los_Angeles"
BR2_LINUX_KERNEL=y
BR2_LINUX_KERNEL_SAME_AS_HEADERS=y
BR2_LINUX_KERNEL_USE_CUSTOM_CONFIG=y
BR2_LINUX_KERNEL_CUSTOM_CONFIG_FILE="board/uplinklabs/linux-3.14.config"
BR2_LINUX_KERNEL_INSTALL_TARGET=y
# BR2_PACKAGE_BUSYBOX is not set
BR2_PACKAGE_BZIP2=y
BR2_PACKAGE_GZIP=y
BR2_PACKAGE_INFOZIP=y
BR2_PACKAGE_LZ4=y
BR2_PACKAGE_LZOP=y
BR2_PACKAGE_DHRYSTONE=y
BR2_PACKAGE_FIO=y
BR2_PACKAGE_GDB=y
BR2_PACKAGE_GDB_DEBUGGER=y
BR2_PACKAGE_GDB_TUI=y
BR2_PACKAGE_KEXEC=y
BR2_PACKAGE_KEXEC_ZLIB=y
BR2_PACKAGE_LATENCYTOP=y
BR2_PACKAGE_LSOF=y
BR2_PACKAGE_MCELOG=y
BR2_PACKAGE_NETPERF=y
BR2_PACKAGE_PERF=y
BR2_PACKAGE_RAMSMP=y
BR2_PACKAGE_STRACE=y
BR2_PACKAGE_WHETSTONE=y
BR2_PACKAGE_BINUTILS_LD_GOLD=y
BR2_PACKAGE_BINUTILS_LD_GOLD_THREADS=y
BR2_PACKAGE_BINUTILS_LD_GOLD_DEFAULT=y
BR2_PACKAGE_DIFFUTILS=y
BR2_PACKAGE_FINDUTILS=y
BR2_PACKAGE_GAWK=y
BR2_PACKAGE_TARGET_GCC=y
BR2_PACKAGE_GIT=y
BR2_PACKAGE_GREP=y
BR2_PACKAGE_LIBTOOL=y
BR2_PACKAGE_MAKE=y
BR2_PACKAGE_PATCH=y
BR2_PACKAGE_PKGCONF=y
BR2_PACKAGE_SED=y
BR2_PACKAGE_TAR=y
BR2_PACKAGE_TREE=y
BR2_PACKAGE_BTRFS_PROGS=y
BR2_PACKAGE_CRYPTSETUP=y
BR2_PACKAGE_DMIDECODE=y
BR2_PACKAGE_HDPARM=y
BR2_PACKAGE_HWLOC=y
BR2_PACKAGE_LM_SENSORS=y
BR2_PACKAGE_LM_SENSORS_SENSORS_DETECT=y
BR2_PACKAGE_MDADM=y
BR2_PACKAGE_MINICOM=y
BR2_PACKAGE_PARTED=y
BR2_PACKAGE_SMARTMONTOOLS=y
BR2_PACKAGE_LIBARCHIVE_BSDTAR=y
BR2_PACKAGE_LIBARCHIVE_BSDCPIO=y
BR2_PACKAGE_CA_CERTIFICATES=y
BR2_PACKAGE_OPENSSL_BIN=y
BR2_PACKAGE_OPENSSL_ENGINES=y
BR2_PACKAGE_CURL=y
BR2_PACKAGE_LIBNL=y
BR2_PACKAGE_ELFUTILS=y
BR2_PACKAGE_ELFUTILS_PROGS=y
BR2_PACKAGE_LIBCAP_TOOLS=y
BR2_PACKAGE_LIBSECCOMP=y
BR2_PACKAGE_LIBUNWIND=y
BR2_PACKAGE_NCURSES_TARGET_PROGS=y
BR2_PACKAGE_SLANG=y
BR2_PACKAGE_BC=y
BR2_PACKAGE_HAVEGED=y
BR2_PACKAGE_BRIDGE_UTILS=y
BR2_PACKAGE_IPROUTE2=y
BR2_PACKAGE_IPTABLES=y
BR2_PACKAGE_IPUTILS=y
BR2_PACKAGE_LINKS=y
BR2_PACKAGE_MOSH=y
BR2_PACKAGE_MTR=y
BR2_PACKAGE_NETCAT_OPENBSD=y
BR2_PACKAGE_NET_TOOLS=y
BR2_PACKAGE_NMAP=y
BR2_PACKAGE_RSYNC=y
BR2_PACKAGE_SOCAT=y
BR2_PACKAGE_WGET=y
BR2_PACKAGE_WHOIS=y
BR2_PACKAGE_PACMAN=y
BR2_PACKAGE_DIALOG=y
BR2_PACKAGE_FILE=y
BR2_PACKAGE_GNUPG2=y
BR2_PACKAGE_LOCKFILE_PROGS=y
BR2_PACKAGE_PINENTRY=y
BR2_PACKAGE_SCREEN=y
BR2_PACKAGE_SUDO=y
BR2_PACKAGE_TIME=y
BR2_PACKAGE_TMUX=y
BR2_PACKAGE_WHICH=y
BR2_PACKAGE_COREUTILS=y
BR2_PACKAGE_FTOP=y
BR2_PACKAGE_HTOP=y
BR2_PACKAGE_IRQBALANCE=y
BR2_PACKAGE_NCDU=y
BR2_PACKAGE_PROCPS_NG=y
BR2_PACKAGE_PSMISC=y
BR2_PACKAGE_SHADOW=y
BR2_PACKAGE_SYSTEMD_ALL_EXTRAS=y
BR2_PACKAGE_SYSTEMD_NETWORKD=y
BR2_PACKAGE_SYSTEMD_TIMESYNCD=y
BR2_PACKAGE_UTIL_LINUX_BINARIES=y
BR2_PACKAGE_UTIL_LINUX_AGETTY=y
BR2_PACKAGE_UTIL_LINUX_ARCH=y
BR2_PACKAGE_UTIL_LINUX_EJECT=y
BR2_PACKAGE_UTIL_LINUX_FALLOCATE=y
BR2_PACKAGE_UTIL_LINUX_FSCK=y
BR2_PACKAGE_UTIL_LINUX_HWCLOCK=y
BR2_PACKAGE_UTIL_LINUX_KILL=y
BR2_PACKAGE_UTIL_LINUX_LAST=y
BR2_PACKAGE_UTIL_LINUX_LOGIN_UTILS=y
BR2_PACKAGE_UTIL_LINUX_LOSETUP=y
BR2_PACKAGE_UTIL_LINUX_MESG=y
BR2_PACKAGE_UTIL_LINUX_MORE=y
BR2_PACKAGE_UTIL_LINUX_MOUNT=y
BR2_PACKAGE_UTIL_LINUX_MOUNTPOINT=y
BR2_PACKAGE_UTIL_LINUX_NEWGRP=y
BR2_PACKAGE_UTIL_LINUX_NOLOGIN=y
BR2_PACKAGE_UTIL_LINUX_PIVOT_ROOT=y
BR2_PACKAGE_UTIL_LINUX_PARTX=y
BR2_PACKAGE_UTIL_LINUX_RENAME=y
BR2_PACKAGE_UTIL_LINUX_RESET=y
BR2_PACKAGE_UTIL_LINUX_SCHEDUTILS=y
BR2_PACKAGE_UTIL_LINUX_SETPRIV=y
BR2_PACKAGE_UTIL_LINUX_SETTERM=y
BR2_PACKAGE_UTIL_LINUX_UNSHARE=y
BR2_PACKAGE_UTIL_LINUX_WALL=y
BR2_PACKAGE_UTIL_LINUX_WRITE=y
BR2_PACKAGE_UTIL_LINUX_ZRAMCTL=y
BR2_PACKAGE_LESS=y
BR2_PACKAGE_NANO=y
BR2_PACKAGE_UEMACS=y
BR2_PACKAGE_VIM=y
# BR2_PACKAGE_VIM_RUNTIME is not set
BR2_TARGET_ROOTFS_CPIO_GZIP=y
BR2_TARGET_ROOTFS_ISO9660=y
# BR2_TARGET_ROOTFS_TAR is not set
BR2_PACKAGE_HOST_MKE2IMG=y
```

## package/arch-install-scripts/Config.in
```kconfig
config BR2_PACKAGE_ARCH_INSTALL_SCRIPTS
	bool "arch-install-scripts"
	# util-linux dependencies
	depends on BR2_LARGEFILE
	# bash dependencies
	depends on BR2_USE_MMU
	select BR2_PACKAGE_BASH
	select BR2_PACKAGE_UTIL_LINUX
	help
	  This is a small suite of scripts aimed at automating some menial
	  tasks when installing Arch Linux.
```

## package/archlinux-keyring/Config.in
```kconfig
config BR2_PACKAGE_ARCHLINUX_KEYRING
	bool "archlinux-keyring"
	default y
	help
	  Arch Linux PGP keyring
```

## package/binutils/Config.in
```kconfig
config BR2_PACKAGE_BINUTILS
	bool "binutils"
	select BR2_PACKAGE_GETTEXT if BR2_NEEDS_GETTEXT_IF_LOCALE
	depends on !BR2_nios2
	depends on BR2_USE_WCHAR
	help
	  Install binutils on the target

if BR2_PACKAGE_BINUTILS

config BR2_PACKAGE_BINUTILS_TARGET
	bool "binutils binaries"
	help
	  The GNU Binutils are a collection of binary tools:

	  ld - the GNU linker.
	  as - the GNU assembler.
	  and others...

	  http://www.gnu.org/software/binutils/

config BR2_PACKAGE_BINUTILS_LD_GOLD
	bool "enable gold linker"
	help
	  Enables the ld.gold linker.

if BR2_PACKAGE_BINUTILS_LD_GOLD

config BR2_PACKAGE_BINUTILS_LD_GOLD_THREADS
	bool "enable multithreaded ld.gold"
	help
	  Enables multithreading in ld.gold

config BR2_PACKAGE_BINUTILS_LD_GOLD_DEFAULT
	bool "make gold linker the default"
	help
	  Makes the gold linker the default linker.

endif

endif

comment "binutils needs a toolchain w/ wchar"
	depends on !BR2_aarch64 && !BR2_nios2
	depends on !BR2_USE_WCHAR
```

## package/cloog/Config.in
```kconfig
config BR2_PACKAGE_CLOOG
    bool "cloog"
	select BR2_PACKAGE_ISL
	help
	  Package cloog for the target
```

## package/isl/Config.in
```kconfig
config BR2_PACKAGE_ISL
    bool "isl"
	select BR2_PACKAGE_GMP
	help
	  Package isl for the target
```

## package/mosh/Config.in
```kconfig
config BR2_PACKAGE_MOSH
	bool "mosh"
	select BR2_PACKAGE_OPENSSH
	select BR2_PACKAGE_PERL
	select BR2_PACKAGE_PROTOBUF
	select BR2_PACKAGE_NCURSES
	select BR2_PACKAGE_PERL
	select BR2_PACKAGE_ZLIB
	help
	  Remote terminal application that allows roaming, supports intermittent
	  connectivity, and provides intelligent local echo and line editing of
	  user keystrokes.

	  Mosh is a replacement for SSH. It's more robust and responsive,
	  especially over Wi-Fi, cellular, and long-distance links.
```

## package/pacman/Config.in
```kconfig
config BR2_PACKAGE_PACMAN
	bool "pacman"
	# bash and libgpgme dependencies
	depends on BR2_USE_MMU
	# libarchive dependency
	depends on BR2_USE_WCHAR
	# gnupg2 dependency
	depends on !BR2_STATIC_LIBS
	select BR2_PACKAGE_BASH
	select BR2_PACKAGE_GNUPG2
	select BR2_PACKAGE_LIBGPGME
	select BR2_PACKAGE_LIBARCHIVE
	select BR2_PACKAGE_LIBCURL
	select BR2_PACKAGE_OPENSSL
	help
	  Pacman is the package manager used by the Arch distribution. It is a
	  frontend for the ALPM (Arch Linux Package Management) library.

	  Pacman does not strive to "do everything." It will add, remove and
	  upgrade packages in the system, and it will allow you to query the
	  package database for installed packages, files and owners. It also
	  attempts to handle dependencies automatically and can download
	  packages from a remote server. Arch packages are simple archives, with
	  .pkg.tar.gz extension for binary packages and .src.tar.gz for source
	  packages.
```

## package/shadow/Config.in
```kconfig
config BR2_PACKAGE_SHADOW
	bool "shadow"
	select BR2_PACKAGE_ACL
	select BR2_PACKAGE_LINUX_PAM
	select BR2_PACKAGE_UTIL_LINUX
	help
	  Password and account management tool suite with support for shadow files
	  and PAM

	  http://pkg-shadow.alioth.debian.org/
```

## package/target-gcc/Config.in
```kconfig
config BR2_PACKAGE_TARGET_GCC
    bool "gcc"
	select BR2_PACKAGE_BINUTILS
	select BR2_PACKAGE_BINUTILS_TARGET
	select BR2_PACKAGE_CLOOG
	select BR2_PACKAGE_ISL
	select BR2_PACKAGE_GMP
	select BR2_PACKAGE_MPC
	select BR2_PACKAGE_MPFR
	help
	  Package gcc for the target
```
